## firmware/board/e200/linux/fpv_capture/Kconfig
```kconfig
config FPV_CAPTURE
	tristate "AntSDR FPV image and spectrum capture"
	depends on OF && HAS_DMA && DMA_ENGINE
	help
	  Exclusive /dev/fpv-capture and /dev/fpv-spectrum interfaces for
	  grayscale frames and FFT snapshots. Uses the Xilinx DMAengine provider.
```

## firmware/board/e310/buildroot/defconfig
```kconfig
BR2_arm=y
BR2_cortex_a9=y
BR2_ARM_ENABLE_NEON=y
BR2_ARM_ENABLE_VFP=y
BR2_ARM_FPU_VFPV3=y
BR2_ARM_EABIHF=y
BR2_TOOLCHAIN_EXTERNAL=y
BR2_TOOLCHAIN_EXTERNAL_CUSTOM=y
BR2_TOOLCHAIN_EXTERNAL_PREINSTALLED=y
BR2_TOOLCHAIN_EXTERNAL_PATH="/opt/Xilinx/Vitis/2022.2/gnu/aarch32/lin/gcc-arm-linux-gnueabi"
BR2_TOOLCHAIN_EXTERNAL_CUSTOM_PREFIX="arm-linux-gnueabihf"
BR2_TOOLCHAIN_EXTERNAL_GCC_11=y
BR2_TOOLCHAIN_EXTERNAL_HEADERS_5_14=y
BR2_TOOLCHAIN_EXTERNAL_CUSTOM_GLIBC=y
BR2_TOOLCHAIN_EXTERNAL_CXX=y
BR2_TOOLCHAIN_EXTERNAL_INET_RPC=n
BR2_TARGET_GENERIC_HOSTNAME="e310"
BR2_TARGET_GENERIC_ISSUE="ANTSDR E310 Buildroot"
BR2_TARGET_GENERIC_ROOT_PASSWD="root"
BR2_TARGET_GENERIC_GETTY_PORT="ttyPS1"
BR2_SYSTEM_DHCP=""
BR2_ROOTFS_OVERLAY="$(BR2_EXTERNAL_MPSOC_IMAGE_BUILDER_PATH)/../board/e310/buildroot/rootfs-overlay"
BR2_ROOTFS_POST_BUILD_SCRIPT="$(BR2_EXTERNAL_MPSOC_IMAGE_BUILDER_PATH)/../board/e310/buildroot/post-build.sh"
BR2_PACKAGE_DROPBEAR_LOCALOPTIONS_FILE="$(BR2_EXTERNAL_MPSOC_IMAGE_BUILDER_PATH)/../board/e310/buildroot/dropbear-localoptions.h"
BR2_TARGET_ROOTFS_CPIO=y
BR2_TARGET_ROOTFS_CPIO_GZIP=y
BR2_PACKAGE_CA_CERTIFICATES=y
BR2_PACKAGE_DROPBEAR=y
BR2_PACKAGE_DOSFSTOOLS=y
BR2_PACKAGE_DOSFSTOOLS_MKFS_FAT=y
BR2_PACKAGE_E2FSPROGS=y
BR2_PACKAGE_ETHTOOL=y
BR2_PACKAGE_FFTW=y
BR2_PACKAGE_FFTW_SINGLE=y
BR2_PACKAGE_IPROUTE2=y
BR2_PACKAGE_I2C_TOOLS=y
BR2_PACKAGE_KMOD=y
BR2_PACKAGE_LIBXCRYPT=y
BR2_PACKAGE_MMC_UTILS=y
BR2_PACKAGE_MTD=y
BR2_PACKAGE_NCURSES=y
BR2_PACKAGE_OPENSSL=y
BR2_PACKAGE_LIBOPENSSL=y
BR2_PACKAGE_PICOCOM=y
BR2_PACKAGE_ROOTFS_FIXUPS=y
BR2_PACKAGE_E200_RADIO_PROBE=y
BR2_FPV_BOARD="e310"
```

## firmware/buildroot-external/Config.in
```kconfig
menu "E200 FPV packages"
source "$BR2_EXTERNAL_MPSOC_IMAGE_BUILDER_PATH/package/e200-radio-probe/Config.in"
source "$BR2_EXTERNAL_MPSOC_IMAGE_BUILDER_PATH/package/rootfs-fixups/Config.in"
endmenu
```

## firmware/buildroot-external/package/e200-radio-probe/Config.in
```kconfig
config BR2_PACKAGE_E200_RADIO_PROBE
	bool "E200 no-OS radio and FPV capture diagnostics"
	help
	  Build fpv-radio-probe and fpv-capture (selected-channel DMA to PGM).
	  No init script is installed; radio access is manual.
```

## firmware/package/Config.in
```kconfig
config BR2_FPV_BOARD
	string "FPV application board profile"
	default "e200"
	help
	  CMake FPV_BOARD used by the shared receiver applications (e200 or e310).
```
